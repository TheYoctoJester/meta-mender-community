## kas/demos/meta-mender-demo-state-scripts/conf/layer.conf
```bitbake
# We have a conf and classes directory, add to BBPATH
BBPATH .= ":${LAYERDIR}"

# We have recipes-* directories, add to BBFILES
BBFILES += "${LAYERDIR}/recipes-*/*/*.bb \
            ${LAYERDIR}/recipes-*/*/*.bbappend"

BBFILE_COLLECTIONS += "meta-mender-demo-state-scripts"
BBFILE_PATTERN_meta-mender-demo-state-scripts = "^${LAYERDIR}/"
BBFILE_PRIORITY_meta-mender-demo-state-scripts = "6"

LAYERDEPENDS_meta-mender-demo-state-scripts = "core"
LAYERSERIES_COMPAT_meta-mender-demo-state-scripts = "scarthgap"
```

## meta-mender-raspberrypi-community/conf/layer.conf
```bitbake
# We have a conf and classes directory, add to BBPATH
BBPATH .= ":${LAYERDIR}"

# We have recipes-* directories, add to BBFILES
BBFILES += "${LAYERDIR}/recipes-*/*/*.bb \
            ${LAYERDIR}/recipes-*/*/*.bbappend"

BBFILE_COLLECTIONS += "meta-mender-raspberrypi-community"
BBFILE_PATTERN_meta-mender-raspberrypi-community = "^${LAYERDIR}/"
BBFILE_PRIORITY_meta-mender-raspberrypi-community = "6"

LAYERDEPENDS_meta-mender-raspberrypi-community = "core"
LAYERSERIES_COMPAT_meta-mender-raspberrypi-community = "kirkstone"
```
