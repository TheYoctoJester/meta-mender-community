## meta-mender-swupdate/wic/image-qemu.wks
```
part /boot --fstype=vfat --ondisk vda --offset 2048s --align 4 --fixed-size 63M --active --label boot --source bootimg-partition

# rootfs slot A
part / --source rootfs --fstype=ext4 --ondisk vda --label root-a --align 4 --fixed-size 256M

# rootfs slot B (empty at flash time; populated by the first SWUpdate OTA)
part --fstype=ext4 --ondisk vda --label root-b --align 4 --fixed-size 256M

# /media (auto-mounted via /etc/fstab)
part --fstype=ext4 --ondisk vda --label media --align 4 --fixed-size 448M

bootloader --ptable msdos --timeout 1
```
